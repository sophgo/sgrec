## sgrec_buildroot_defconfig
```kconfig
BR2_riscv=y
BR2_RISCV_ISA_RVC=y
BR2_KERNEL_HEADERS_6_6=y
BR2_PACKAGE_GLIBC_UTILS=y
BR2_GCC_VERSION_15_X=y
BR2_TOOLCHAIN_BUILDROOT_CXX=y
BR2_CCACHE=y
BR2_TARGET_GENERIC_HOSTNAME="SGREC"
BR2_TARGET_GENERIC_ISSUE="SOPHGO RECOVERY"
BR2_INIT_SYSTEMD=y
BR2_TARGET_GENERIC_ROOT_PASSWD="SophgoRecovery"
BR2_SYSTEM_BIN_SH_BASH=y
BR2_PACKAGE_BROTLI=y
BR2_PACKAGE_GZIP=y
BR2_PACKAGE_LRZIP=y
BR2_PACKAGE_LZIP=y
BR2_PACKAGE_LZOP=y
BR2_PACKAGE_P7ZIP=y
BR2_PACKAGE_PIGZ=y
BR2_PACKAGE_PIXZ=y
BR2_PACKAGE_UNRAR=y
BR2_PACKAGE_UNZIP=y
BR2_PACKAGE_ZIP=y
BR2_PACKAGE_ZSTD=y
BR2_PACKAGE_FIO=y
BR2_PACKAGE_GDB=y
BR2_PACKAGE_KEXEC=y
BR2_PACKAGE_KEXEC_ZLIB=y
BR2_PACKAGE_LMBENCH=y
BR2_PACKAGE_LSOF=y
BR2_PACKAGE_NETPERF=y
BR2_PACKAGE_STRACE=y
BR2_PACKAGE_STRESS_NG=y
BR2_PACKAGE_GAWK=y
BR2_PACKAGE_MAKE=y
BR2_PACKAGE_PATCH=y
BR2_PACKAGE_PKGCONF=y
BR2_PACKAGE_SED=y
BR2_PACKAGE_TREE=y
BR2_PACKAGE_AUTOFS=y
BR2_PACKAGE_BTRFS_PROGS=y
BR2_PACKAGE_CIFS_UTILS=y
BR2_PACKAGE_CIFS_UTILS_SMBTOOLS=y
BR2_PACKAGE_CPIO=y
BR2_PACKAGE_CRAMFS=y
BR2_PACKAGE_DOSFSTOOLS=y
BR2_PACKAGE_DOSFSTOOLS_FATLABEL=y
BR2_PACKAGE_DOSFSTOOLS_FSCK_FAT=y
BR2_PACKAGE_DOSFSTOOLS_MKFS_FAT=y
BR2_PACKAGE_E2TOOLS=y
BR2_PACKAGE_EROFS_UTILS=y
BR2_PACKAGE_EROFS_UTILS_LZ4=y
BR2_PACKAGE_EROFS_UTILS_LZMA=y
BR2_PACKAGE_EROFS_UTILS_EROFSFUSE=y
BR2_PACKAGE_EXFAT=y
BR2_PACKAGE_EXFAT_UTILS=y
BR2_PACKAGE_EXFATPROGS=y
BR2_PACKAGE_F2FS_TOOLS=y
BR2_PACKAGE_MTD=y
BR2_PACKAGE_SSHFS=y
BR2_PACKAGE_ZEROFREE=y
BR2_PACKAGE_ACPICA=y
BR2_PACKAGE_ACPID=y
BR2_PACKAGE_ACPITOOL=y
BR2_PACKAGE_AER_INJECT=y
BR2_PACKAGE_I2C_TOOLS=y
BR2_PACKAGE_IPMITOOL=y
BR2_PACKAGE_IPMITOOL_LANPLUS=y
BR2_PACKAGE_IPMITOOL_USB=y
BR2_PACKAGE_IPMITOOL_IPMIEVD=y
BR2_PACKAGE_IPMITOOL_IPMISHELL=y
BR2_PACKAGE_LSHW=y
BR2_PACKAGE_LSSCSI=y
BR2_PACKAGE_LSUIO=y
BR2_PACKAGE_MEMTESTER=y
BR2_PACKAGE_MEMTOOL=y
BR2_PACKAGE_MHZ=y
BR2_PACKAGE_NVME=y
BR2_PACKAGE_RTC_TOOLS=y
BR2_PACKAGE_USBUTILS=y
BR2_PACKAGE_WIPE=y
BR2_PACKAGE_BC=y
BR2_PACKAGE_DHCP=y
BR2_PACKAGE_DHCP_CLIENT=y
BR2_PACKAGE_DHCPDUMP=y
BR2_PACKAGE_ETHTOOL=y
BR2_PACKAGE_FPING=y
BR2_PACKAGE_IFTOP=y
BR2_PACKAGE_IFUPDOWN=y
BR2_PACKAGE_IPERF3=y
BR2_PACKAGE_IPSET=y
BR2_PACKAGE_IPUTILS=y
# BR2_PACKAGE_OPENSSH_SERVER is not set
# BR2_PACKAGE_OPENSSH_KEY_UTILS is not set
# BR2_PACKAGE_OPENSSH_SANDBOX is not set
BR2_PACKAGE_RSYNC=y
BR2_PACKAGE_SAMBA4=y
BR2_PACKAGE_ZSH=y
BR2_PACKAGE_BASH_COMPLETION=y
BR2_PACKAGE_SCREEN=y
BR2_PACKAGE_TMUX=y
BR2_PACKAGE_WHICH=y
BR2_PACKAGE_COREUTILS=y
BR2_PACKAGE_CPULIMIT=y
BR2_PACKAGE_CPULOAD=y
BR2_PACKAGE_EFIBOOTMGR=y
BR2_PACKAGE_HTOP=y
BR2_PACKAGE_IOTOP=y
BR2_PACKAGE_NUMACTL=y
BR2_PACKAGE_TAR=y
BR2_PACKAGE_UTIL_LINUX_BINARIES=y
BR2_PACKAGE_UTIL_LINUX_HARDLINK=y
BR2_PACKAGE_UTIL_LINUX_HWCLOCK=y
BR2_PACKAGE_UTIL_LINUX_IRQTOP=y
BR2_PACKAGE_UTIL_LINUX_KILL=y
BR2_PACKAGE_UTIL_LINUX_LAST=y
BR2_PACKAGE_UTIL_LINUX_LINE=y
BR2_PACKAGE_UTIL_LINUX_LOSETUP=y
BR2_PACKAGE_UTIL_LINUX_LSFD=y
BR2_PACKAGE_UTIL_LINUX_LSLOGINS=y
BR2_PACKAGE_UTIL_LINUX_LSMEM=y
BR2_PACKAGE_UTIL_LINUX_MORE=y
BR2_PACKAGE_UTIL_LINUX_PARTX=y
BR2_PACKAGE_UTIL_LINUX_SU=y
BR2_PACKAGE_UTIL_LINUX_SWITCH_ROOT=y
BR2_PACKAGE_ED=y
BR2_PACKAGE_LESS=y
BR2_PACKAGE_VIM=y
```
